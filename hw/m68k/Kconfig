## hw/m68k/Kconfig
```kconfig
config AN5206
    bool
    select COLDFIRE
    select PTIMER

config MCF5208
    bool
    select COLDFIRE
    select PTIMER

config Q800
    bool
    select FRAMEBUFFER
    select ADB
    select MAC_VIA
    select ESCC
    select ESP
    select MACFB
    select NUBUS
    select DP8393X
    select SWIM
```
